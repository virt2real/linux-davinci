## arch/arm/mach-davinci/Kconfig
```kconfig
if ARCH_DAVINCI

menu "TI DaVinci Implementations"

comment "DaVinci Core Type"

config ARCH_DAVINCI644x
	default y
	bool "DaVinci 644x based system"

comment "DaVinci Board Type"

config MACH_DAVINCI_EVM
	bool "TI DaVinci EVM"
	default y
	depends on ARCH_DAVINCI644x
	help
	  Configure this option to specify the whether the board used
	  for development is a DaVinci EVM

config DAVINCI_MCBSP
	bool
        prompt "DaVinci McBSP Driver" if SOUND_DAVINCI=n
	depends on ARCH_DAVINCI
	default SOUND_DAVINCI
	---help---
	DaVinci McBSP driver.  Auto-enabled by DaVinci sound driver.

config DAVINCI_RESET_CLOCKS
	bool "Reset unused clocks during boot"
	depends on ARCH_DAVINCI
	help
	  Say Y if you want to reset unused clocks during boot.
	  This option saves power, but assumes all drivers are
	  using the clock framework. Broken drivers that do not
	  yet use clock framework may not work with this option.
	  If you are booting from another operating system, you
	  probably do not want this option enabled until your
	  device drivers work properly.

config DAVINCI_BOOT_TAG
	bool "DaVinci bootloader information passing"
        depends on ARCH_DAVINCI644x
        default n
        help
          Say Y, if you have a bootloader which passes information
          about your board and its peripheral configuration.

comment "DaVinci Options"

config DAVINCI_BLK_DEV_CF
	bool "TI DaVinci CF Card Support"
	default Y
	depends on BLK_DEV_DAVINCI
	help
	  Configure this option to enable CF Card support.

endmenu

endif
```

## drivers/v2r/IMU/Kconfig
```kconfig
menuconfig V2R_IMU_DRIVERS
	bool "Virt2real IMU board"
	---help---
	Virt2real IMU board devices

if V2R_IMU_DRIVERS

config V2R_BMA180
	depends on V2R_IMU_DRIVERS
	tristate "BMA180 driver"
	default y
	---help---
	BMA180 accelerometer

config V2R_BMP085
	depends on V2R_IMU_DRIVERS
	tristate "BMP085 driver"
	default y
	---help---
	BMP085 barometer and gradusnik

config V2R_HMC5843
	depends on V2R_IMU_DRIVERS
	tristate "HMC5843 driver"
	default y
	---help---
	HMC5843 digital compass

config V2R_ITG3200
	depends on V2R_IMU_DRIVERS
	tristate "ITG3200 driver"
	default y
	---help---
	ITG3200 gyroscope

endif
```

## drivers/v2r/Kconfig
```kconfig
menuconfig V2R_DRIVERS
	bool "Virt2real device drivers"
	---help---
	Virt2real onboard devices

if V2R_DRIVERS
source "drivers/v2r/IMU/Kconfig"	
endif

if V2R_DRIVERS
source "drivers/v2r/init/Kconfig"	
endif

config V2R_ADC
	depends on V2R_DRIVERS
	tristate "ADC driver"
	default y
	---help---
	Virt2real ADC driver (6 channels)

config V2R_PINS
	depends on V2R_DRIVERS
	tristate "pins driver"
	default y
	---help---
	Virt2real pins driver

config V2R_GPIO
	depends on V2R_DRIVERS
	tristate "GPIO driver"
	default y
	---help---
	Virt2real GPIO driver

config V2R_GPIOEVENT
	depends on V2R_DRIVERS
	tristate "GPIO event driver"
	default y
	---help---
	Virt2real GPIO event driver. Taken from Gumstix.

config V2R_EXTPWM
        depends on V2R_DRIVERS
        tristate "External PWM driver"
        default y
        ---help---
        Virt2real External PWM driver

config V2R_SWPWM
	depends on V2R_DRIVERS
	tristate "Software PWM driver"
	default n
	---help---
	Virt2real Software PWM driver (not good yet). Clocked by TIMER3.
	
config V2R_SWPWM_DEBUG
	depends on V2R_DRIVERS && V2R_SWPWM
	tristate "Debug output"
	default n
	---help---
	Virt2real Software PWM driver debug output

config V2R_PPMSUM
	depends on V2R_DRIVERS
	tristate "PPMSUM driver"
	default n
	---help---
	Virt2real PPMSUM driver output. Not stable, FOR TESTING ONLY!

choice
	prompt "Video capture mode"
	default V2R_VIDEO_OV2643_SD

config V2R_VIDEO_OV2643_SD
	bool "OV2643 - SD 640x480"
	select VIDEO_OV2643

config V2R_VIDEO_OV2643_HD
	bool "OV2643 - HD 720p"
	select VIDEO_OV2643

config V2R_VIDEO_TVP5150
	bool "TVP5150 - analog"
	select VIDEO_TVP5150

config V2R_VIDEO_ADV7611
	bool "ADV7611 - HDMI"
	select VIDEO_ADV7611
endchoice
```

## drivers/v2r/init/Kconfig
```kconfig
menuconfig V2R_INIT
	bool "Boot process"
	---help---
	Any settings for boot process

if V2R_INIT

config V2R_PARSE_CMDLINE

	bool "parse kernel cmdline"
	default y
	---help---
	Allow virt2real init function to parse kernel cmdline (from uEnv.txt) for device initialization

config V2R_VIDEOOUTALWAYSON

	bool "VideoOut always ON"
	default y
	---help---
	Allow virt2real do not disable video out if camera not connected

config V2R_DEBUG

	bool "Turn ON kernel debug output"
	default y
	---help---
	Allow  kernel make debug output

endif
```
